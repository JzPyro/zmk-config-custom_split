#include "customsplit.dtsi"

&default_transform {
    col-offset = <5>;
};

&kscan0 {
    col-gpios = <&gpio0 20 GPIO_ACTIVE_HIGH>,
                <&gpio0 17 GPIO_ACTIVE_HIGH>,
                <&gpio0 15 GPIO_ACTIVE_HIGH>,
                <&gpio1 11 GPIO_ACTIVE_HIGH>,
                <&gpio0 26 GPIO_ACTIVE_HIGH>;
};
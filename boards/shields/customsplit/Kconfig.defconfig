## boards/shields/customsplit/Kconfig.sheild
```kconfig
config SHIELD_CUSTOMSPLIT_LEFT
    def_bool $(shields_list_contains,customsplit)

config SHIELD_CUSTOMSPLIT_RIGHT
    def_bool $(shields_list_contains,customsplit)
```

## config/boards/shields/customsplit/Kconfig.shield
```kconfig
config SHIELD_CUSTOMSPLIT_LEFT
    def_bool $(shields_list_contains,customsplit_left)

config SHIELD_CUSTOMSPLIT_RIGHT
    def_bool $(shields_list_contains,customsplit_right)
```
